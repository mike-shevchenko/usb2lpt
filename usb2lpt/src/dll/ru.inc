// translated by Artem Korotkov

// DIALOG(EX)
#define S10000	"Эмуляция"
#define S10001	"Эмулируемый &адрес порта:"
#define S10002	"Расшир&енный режим LPT:"
#define S10003	"Метод прерывания для команд IN/OUT"
#define S10004	"&Прерывание отладочного регистра"
#define S10005	"(перехватывает все типы IN/OUT команд)"
#define S10006	"При&нудительное распределение, даже если уже распределены"
#define S10007	"READ/WRITE_PORT_UCHAR/USHORT/ULONG &перенаправления"
#define S10008	"(быстрее, более стабильно)"
#define S10009	"Параметры"
#define S10010	"Используйте кэш записи для &команд OUT"
#define S10011	"(Объединение нескольких команд OUT в один USB-пакет)"
#define S10012	"Отправить пакет после &временной задержки:"
#define S10013	"мс"
#define S10014	"&Эхосчитывание локальной копии выходных регистров"
#define S10015	"&Точнее…"
#define S10016	"(возвращает последнее записанное значение в IN команду; не работает, когда выходы управляются посредством внешних аппаратных средств [низкий сигнал])"

#define S10100	"Статистика"
#define S10101	"Регистр отладки – вывод"
#define S10102	"&Сброс в нуль"
#define S10103	"Команда OUT:"
#define S10104	"Команда IN:"
#define S10105	"Ошибки эмуляции:"
#define S10106	"(неподдерживаемая I/O команда, напр. OUTSB)"
#define S10107	"Захваченные отладочные регистры:"
#define S10108	"(Неизвестный драйвер перезаписал отладочный регистр)"
#define S10109	"Перезаписанные отладочные регистры детектируется таймером в 100 мс."
#define S10110	"Действительно присвоен на:"
#define S10114	"READ_PORT_UCHAR/WRITE_PORT_UCHAR перенаправления"
#define S10115	"Сброс в &нуль"
#define S10116	"Сверхдлина:"
#define S10117	"USB2LPT Сп&ециальные добавки…"
#define S10118	"Обновление &микропрограммного обеспечения…"
#define S10119	"haftmann#software, Технический университет Хемница, факультет электротехники и информатики, кафедра использования датчиков и измерительной техники, 2006-2009 г."

#define S10200	"Эхосчитавающая копия выходных регистров"
#define S10201	"Порт &данных (базовый адрес + 0)"
#define S10202	"&Контрольный порт (базовый адрес + 2)"
#define S10203	"&Другие порты (ECP, EPP)"
#define S10204	"OK"
#define S10205	"Отмена"

#define S10302	"Неправильные настройки могут привести к сбою компьютера или повредить содержимое вашего жесткого диска! Использование одного из трех предопределенных адресов должно быть безопасным."
#define S10304	"Расширенный метод LPT позволят перехватывать дополнительные адреса портов. Метод используются редко, достаточно SPP настройки."
#define S10305	"Эти и дальнейшие настройки можно выполнить позже в диспетчере устройств Windows. Перейдите к USB2LPT устройству и откройте свойства."

#define S10400	"USB2LPT Специальные добавки"
#define S10401	"Регистр Функций"
#define S10402	"(Регистр Функций постоянно хранится в EEPROM USB2LPT устройства. Доступ через DeviceIoControl)"
#define S10403	"Открытые коллекторa для портa &данных (+0)"
#define S10404	"Открытые коллекторa для &контрольного порта (+2)"
#define S10405	"&Выключите Pullup'ы (и 5V на Pin25, если проводной)"
#define S10406	"&Прямой In/Out режим (USB2LPT преобразуется в I/O устройства)"
#define S10407	"(Создает слабое выходное напряжение 5V вместо сильного 3.3V)"
#define S10408	"(Флажок серого цвета означает: открытые коллектора в режиме SPP, иначе – двухтактный)"
#define S10409	"(только энергосбережение)"
#define S10410	"(Инвертирование отпадает. Отсутствие полезного LPT-эмулирования для доступа через DeviceIoControl. В случае Rev.4 имеется 20 I/O линий вместо 17. Направлении включаемо отдельно для каждого вывода.)"
#define S10411	"&Установка и эхосчитывание"
#define S10412	"&Сканирование короткого замыкания"
#define S10413	"Серийный номер"
#define S10414	"в &USB-дескриптора"
#define S10415	"Дата микропрограммного обеспечения"
#define S10416	"Приглушенный с&иний светодиод"
#define S10417	"Запуск знач&ение для ECR (рабочий режим):"

#define S10500	"Монитор"
#define S10501	"&Порт данных (+0)"
#define S10502	"Читать"
#define S10503	"&Статус-порт (+1)"
#define S10504	"&Контрольный порт (+2)"
#define S10506	"&Читать байт"
#define S10507	"&Адрес"
#define S10508	"&Данные"
#define S10509	"&Записать байт"
#define S10512	"FIFO полный"
#define S10513	"FIFO пуст"
#define S10514	"Регистр направления (USB2LPT особенность)"

// STRINGTABLE
#define S16 "Вы действительно хотите использовать эти нестандартные адреса портов? Данные значениями могут повредить компьютер!"
#define S17 "Этот адрес не является действительным шестнадцатеричным числом!"
#define S18 "Этот адрес порта недопустим: слишком мал, слишком велик, или не делится на 4!"
#define S19 "Для порта с адресом, не делящимся на 8, EPP эмуляция не возможна!"
#define S20 "Недействительное значение времени ожидания! (Не должно превышать 1000 мс.)"
#define S21 "Определение эмулированного порт-адреса."
#define S22 "Этот адрес порта должен совпадать с адресом, используемым вашим прикладным программным обеспечением."
#define S23 "Данная прошивка не поддерживает регистр функций."
#define S24 "никакой"	// serial number
#define S25 "Контекстная &справка"
#define S26 "&Bulk transfer (faster; good for XP and earlier)"
#define S27 "Interrupt transfer otherwise"
#define S28 "Activating bulk transfer renders USB2LPT defective under Windows Vista and newer!\nRemember to reset this bit before upgrading your system.\n\nПродолжить?"
#define S29 "The debug register trap hook will be detected by PatchGuard some minutes later, which results in BSoD 0x109 when no countermeasure was taken.\n\nПродолжить?"

#define S32 "Микропрограмма успешно записана в EEPROM. Для запуска новой прошивки необходимо прибор отсоединить и снова подсоединить его."
#define S33 "Неизвестная ошибка при записи микропрограммы в EEPROM. Пожалуйста, не отключайте устройство и попробуйте еще раз. Возможно, USB2LPT устройство больше не работает!"
#define S34 "Файл «%s» не является прошивкой для устройства USB2LPT!"
#define S35 "Дата актуальной микропрограммы (firmware): %s\n\nДата записываемой микропрограммы: %s\n\nПродолжить?"
#define S36 "неизвестно"		// firmware date (early releases have no date inside)
#define S37 "Микропрограмма\0*.iic"	// filter for open file standard dialog
#define S38 "Совершенные функции."
#define S39 "Обнаружена неверная функция! Запустите Kurzschlusstest.EXE для более подробной информации."
#define S40 "Высокий уровень измерен на всех 17 линиях?"
#define S41 "Микропрограмма для устройств USB2LPT с ATmega контроллер не может выполнить обновление, но вы можете установить флаг для активации встроенного в загрузчике boot режима. После установки флага необходимо обновить с помощью bootloadHID.EXE.\n\nПродолжить?"
#define S42 "Этот USB2LPT не support firmware update via USB.\n\n(First EEPROM byte = 0x%02X)"

#define S48 "SPP (полубайт)\0Двунаправленные\0Авто строб\0ECP\0EPP\0Защищены\0Тестовыи режим\0Конфигурация"
#define S49 "дополнительно\0защищены\0Запрос прерывания\0Ошибка\0Онлайн\0Конец бумаги\0Признать\0Занятый"
#define S50 "Строб\0Автоматическая подача\0Инициализации\0Выбор вход\0Прерывание разрешено\0Направление данных, 1 = входное\0отсутствует"
#define S51 "К&оманда\0&Адрес"		// Changing text for radio button 105/122
#define S52 "нормально\0Режим полубайт\0Режим байт\0Режим ECP\0Режим EPP"

// VERSIONINFO
#define I002	25,1
#define S003	"Поставщик листов с указанием свойств"	// FileDescription
#define S005	"Общественный домен"		// LegalCopyright
#define S006	"h#s конвертер USB к LPT"	// ProductName
#define S007	"Драйвер режима ядра"		// FileDescription for .SYS driver

/* INF file strings (processed by makefile)
InstDisk="h#s дискета для конвертера USB к LPT"
DevDesc ="h#s конвертер USB к LPT"
SvcDesc ="h#s драйвер для конвертера USB к LPT (usb2lpt.sys)"
*/
